## kernel_drivers/sammykernelmodules/Config.in
```kconfig
config BR2_PACKAGE_SAMMYKERNELMODULES
	bool "Sammy kernel modules"
	
	help
	  This is the kernel modules source directory
```

## sammytechplayground/Config.in
```kconfig
config BR2_PACKAGE_SAMMYTECHPLAYGROUND
	bool "Sammy Tech Playground"
	select BR2_PACKAGE_JSON_C
	select BR2_PACKAGE_LIBYAML

	help
	  Mypackage - This is a package containing the coding samples 
	  for Sammy Tech Playground buildroot system
```
